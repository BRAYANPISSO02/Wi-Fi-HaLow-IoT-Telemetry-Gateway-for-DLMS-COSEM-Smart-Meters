## tcp2uart_rs485/sdkconfig.defaults
```kconfig
CONFIG_BLINK_LED_GPIO=y
CONFIG_BLINK_GPIO=15
# Wi-Fi
CONFIG_ESP_WIFI_ENABLED=y
CONFIG_ESP_WIFI_DEFAULT_WIFI_INIT_CONFIG=y

# Provisioning Manager
CONFIG_WIFI_PROV_ENABLED=y
CONFIG_WIFI_PROV_SEC_ENABLED=y
CONFIG_WIFI_PROV_SECURITY_VERSION_1=y

# Desactivar BLE provisioning
CONFIG_WIFI_PROV_BLE_FORCE_DISABLE=y
CONFIG_BT_ENABLED=n
CONFIG_BT_BLUEDROID_ENABLED=n
CONFIG_BT_NIMBLE_ENABLED=n

# Activar SoftAP provisioning
CONFIG_WIFI_PROV_SOFTAP_FORCE_ENABLE=y

# Logging (opcional)
CONFIG_LOG_DEFAULT_LEVEL_INFO=y
```
